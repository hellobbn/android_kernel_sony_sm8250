## drivers/voyager/Kconfig
```kconfig
# SPDX-License-Identifier: GPL-2.0-only

config VOYAGER_ADDON
	tristate "Enable special features added by voyager kernel"
	help
	This will enable additional features.


source "drivers/voyager/sched/Kconfig"
```

## drivers/voyager/sched/Kconfig
```kconfig
# SPDX-License-Identifier: GPL-2.0-only

config SCHED_EXT
	tristate "Support sched extention"
	help
	This will enable the features ported from the upstream.

config SCHED_EXT_DEBUG
	tristate "Support sched extention debug"
	help
	This will debug the features ported from the upstream.

source "drivers/voyager/sched/walt/Kconfig"
```

## drivers/voyager/sched/walt/Kconfig
```kconfig
# SPDX-License-Identifier: GPL-2.0-only

config WALT_EXT
	tristate "Support window based load tracking extention"
	help
	This will enable the features ported from the upstream walt module.
```
